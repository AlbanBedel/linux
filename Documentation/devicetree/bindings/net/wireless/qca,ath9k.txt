## Documentation/devicetree/bindings/net/wireless/qca,ath9k.txt
```
* Qualcomm Atheros ath9k wireless devices

This node provides properties for configuring the ath9k wireless device. The
node is expected to be specified as a child node of the PCI controller to
which the wireless chip is connected.

Required properties:
- compatible: For PCI and PCIe devices this should be an identifier following
		the format as defined in "PCI Bus Binding to Open Firmware"
		Revision 2.1. One of the possible formats is "pciVVVV,DDDD"
		where VVVV is the PCI vendor ID and DDDD is PCI device ID.
		Typically QCA's PCI vendor ID 168c is used while the PCI device
		ID depends on the chipset - see the following (possibly
		incomplete) list:
			- 0023 for AR5416
			- 0024 for AR5418
			- 0027 for AR9160
			- 0029 for AR9220 and AR9223
			- 002a for AR9280 and AR9283
			- 002b for AR9285
			- 002c for AR2427
			- 002d for AR9227
			- 002e for AR9287
			- 0030 for AR9380, AR9381 and AR9382
			- 0032 for AR9485
			- 0033 for AR9580 and AR9590
			- 0034 for AR9462
			- 0036 for AR9565
			- 0037 for AR9485
		For SoC devices the compatible should be "qca,<soctype>-wmac"
		and one of the following fallbacks:
			- "qca,ar9100-wmac"
			- "qca,ar9330-wmac"
			- "qca,ar9340-wmac"
			- "qca,qca9550-wmac"
			- "qca,qca9530-wmac"
- reg: Address and length of the register set for the device.

Required properties for SoC devices:
- interrupt-parent: phandle of the parent interrupt controller.
- interrupts: Interrupt specifier for the controllers interrupt.

Optional properties:
- mac-address: See ethernet.txt in the parent directory
- local-mac-address: See ethernet.txt in the parent directory
- clock-names: has to be "ref"
- clocks: phandle of the reference clock
- resets: phandle of the reset line
- nvmem-cell-names: has to be "eeprom" and/or "address"
- nvmem-cells: phandle to the eeprom nvmem cell and/or to the mac address
		nvmem cell.

Deprecated properties:
- qca,no-eeprom: Indicates that there is no physical EEPROM connected to the
			ath9k wireless chip (in this case the calibration /
			EEPROM data will be loaded from userspace using the
			kernel firmware loader).

In this example, the node is defined as child node of the PCI controller:
&pci0 {
	wifi@168c,002d {
		compatible = "pci168c,002d";
		reg = <0x7000 0 0 0 0x1000>;
		qca,no-eeprom;
	};
};

In this example it is defined as a SoC device:
	wifi@180c0000 {
		compatible = "qca,ar9132-wmac", "qca,ar9100-wmac";
		reg = <0x180c0000 0x30000>;

		interrupt-parent = <&cpuintc>;
		interrupts = <2>;

		clock-names = "ref";
		clocks = <&extosc>;

		nvmem-cell-names = "eeprom", "address";
		nvmem-cells = <&wmac_eeprom>, <&wmac_address>;

		resets = <&rst 22>;
	};
```

## Documentation/devicetree/bindings/nvmem/mtd-nvmem.txt
```
= NVMEM in MTD =

Config data for drivers, like MAC addresses, is often stored in MTD.
An MTD device, or one of its partition, can be defined as a NVMEM provider
by having an 'nvmem-cells' subnode as defined in nvmem.txt.

Example:

	flash@0 {
		...

		partition@2 {
			label = "art";
			reg = <0x7F0000 0x010000>;
			read-only;

			nvmem-cells {
				compatible = "nvmem-cells";
				#address-cells = <1>;
				#size-cells = <1>;

				eeprom@1000 {
					reg = <0x1000 0x1000>;
				};
			};
		};
	};
```
